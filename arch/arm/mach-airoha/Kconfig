## board/mediatek/Kconfig
```kconfig
if ARCH_MEDIATEK || ARCH_MTMIPS

menu "Mediatek specific configurations"

menu "Mediatek Failsafe Web recovery"

config MTK_WEB_FAILSAFE
	bool "Enable failsafe Web recovery"
	select WEBUI_FAILSAFE
	help
	  Enable the Mediatek failsafe Web recovery feature.

menuconfig MTK_FAILSAFE_VALIDATE
	bool "Enable failsafe image validation"
	depends on MTK_WEB_FAILSAFE
	help
	  Master switch for all structural image validation performed by
	  the failsafe Web recovery before flashing (failsafe_validate.c).

	  Independently of this compile-time switch, the runtime
	  environment variable "failsafe_validate" can disable the
	  structural validation on a running device (set it to 0/no);
	  the generic storage capacity checks are always performed.

if MTK_FAILSAFE_VALIDATE

if ARM

config MTK_FAILSAFE_VALIDATE_BL2
	bool "Validate 'bl2' (preloader) images"
	default y
	help
	  Structurally validate uploaded 'bl2' images before they are
	  flashed.

config MTK_FAILSAFE_VALIDATE_FIP
	bool "Validate 'fip' images"
	default y
	help
	  Structurally validate uploaded 'fip' (UBI static volume) images
	  before they are flashed.

	  The U-Boot the FIP ships is also checked against this board (the
	  'compatible' of the device tree U-Boot carries must match),
	  unless the environment variable "failsafe_strict_model" is set
	  to 0 on the running device.  A U-Boot stored compressed inside
	  the FIP (XZ, when MediaTek FIP compression is enabled) is
	  expanded first, which needs CONFIG_XZ; without the decoder the
	  check is skipped.

endif # ARM

config MTK_FAILSAFE_VALIDATE_UBOOT
	bool "Validate 'u-boot' images (MIPS: SPL / payload + U-Boot)"
	depends on MIPS && OF_LIBFDT
	default y
	help
	  Validate uploaded 'u-boot' images before they are flashed.

	  The MIPS SoCs have no FIP: the 'u-boot' storage holds the whole
	  bootloader image, with the U-Boot inside it - SPL + U-Boot
	  packed as a legacy uImage (u-boot-with-spl.bin, u-boot-lzma.img)
	  on MediaTek MIPS, a TCBoot loader with the U-Boot payload behind
	  it on EcoNet.
	  
	  Such an image is accepted only when it carries a
	  U-Boot - a valid legacy uImage (header and data CRC), or its
	  control device tree.  This part is structural and deliberately
	  strict, because this storage has no other guard (there is no FIP
	  ToC to validate); it is not affected by "failsafe_strict_model",
	  only by the master "failsafe_validate" switch (or by disabling
	  this option).

	  The 'compatible' list of that device tree is then compared with
	  the one of the running U-Boot, entry by entry, with the shorter
	  list having to be a prefix of the longer one (the same rule the
	  reference implementation applies) - so a bootloader built for
	  another board is rejected even when it shares this SoC.  The
	  environment variable "failsafe_strict_model" (on by default, 0
	  disables it) turns that comparison off, and
	  "failsafe_compatible_num" = N relaxes it for a bootloader
	  shared by several board variants: the first N entries of this
	  board's own list then name the boards it accepts, and the image
	  passes as soon as it declares one of them.

	  A U-Boot stored compressed (LZMA on MediaTek MIPS) is expanded
	  first, which needs CONFIG_LZMA; without the decoder the board
	  comparison is skipped while the U-Boot itself still has to be
	  there.

config MTK_FAILSAFE_VALIDATE_FIRMWARE
	bool "Validate 'firmware' images"
	depends on FIT
	default y
	help
	  Validate uploaded 'firmware' images (OpenWrt kernel/rootfs FIT,
	  UBI volume) with the FIT checker (fit_check_format) before
	  they are flashed.

endif # MTK_FAILSAFE_VALIDATE

config MTK_FAILSAFE_VERIFY_WRITE
	bool "Verify the flashed image (read back and compare)"
	depends on MTK_WEB_FAILSAFE
	default y
	help
	  Read every image back from the storage it was just written to
	  and compare it with the uploaded image (the DRAM staging
	  buffer), so a write that did not land - a bad flash block, a
	  dying cell, a storage driver problem - fails the upgrade right
	  away instead of being discovered during the next boot.

	  This is the post-write half of the validation: the checks of the
	  "Mediatek Failsafe Web recovery" menu above run on the uploaded
	  image before it is written, this one checks what the flash
	  actually holds afterwards.  It costs one full read of the image
	  per upgrade, no extra RAM (the comparison runs in 64 KiB
	  chunks) and applies to every image type the Web UI can write:

	    firmware    read back from the same FIT volume / partition
	                the write path resolved,
	    fip         'fip' UBI static volume / MMC partition,
	    u-boot      'u-boot' storage (MIPS: SPL / payload + U-Boot),
	    bl2         read back from where the bootrom expects the
	                preloader: the 'bl2' MTD partition, the 'bl2'
	                partition of an SD card, or the boot0 hardware
	                partition of an eMMC.

	  The GPT image is excluded: it is adjusted to the device size
	  while it is written, so it does not match the upload, and the
	  GPT writer already reads both of its copies back and verifies
	  them itself.

	  Independently of this compile-time switch, the runtime
	  environment variable "failsafe_verify" can disable the read-back
	  verification on a running device (set it to 0/no; unset means
	  on).

endmenu # Mediatek Failsafe Web recovery

config MTK_DEFAULT_FIT_BOOT_CONF
	string "Default boot configuration of FIT image"
	default ""
	help
	  FIT image can store multiple boot configuration to allow one sinle
	  FIT image to be used on multiple boards.
	  If left empty, the default one specified in FIT will be used.

config MTK_EFUSE
	bool "Enable MediaTek eFuse support (SMC to secure monitor)"
	depends on ARM
	select ARM_SMCCC
	default n
	help
	  Provide the MediaTek eFuse library (mtk_efuse.c) that talks to
	  the secure monitor through an SMC (ARM SMC Calling Convention) to
	  read / write / disable eFuse fields.  Disabled by default; enable
	  only when the secure monitor exposes the MTK eFuse SMC services.

config MTK_EFUSE_CMD
	bool "Enable 'efuse' U-Boot command (MTK eFuse read/write)"
	depends on MTK_EFUSE
	default n
	help
	  Provide the 'efuse' U-Boot command (read / write sub-commands)
	  built on top of the MediaTek eFuse library.  Disabled by default;
	  enable together with MTK_EFUSE.

endmenu # Mediatek specific configurations

endif # ARCH_MEDIATEK || ARCH_MTMIPS
```

## configs/an7581_evb-ramboot_defconfig
```kconfig
CONFIG_ARM=y
CONFIG_ARCH_AIROHA=y
CONFIG_POSITION_INDEPENDENT=y
CONFIG_BOOTDELAY=3
CONFIG_AUTOBOOT_KEYED=y
CONFIG_AUTOBOOT_MENU_SHOW=y
CONFIG_TARGET_AN7581=y
CONFIG_TEXT_BASE=0x81e00000
CONFIG_SYS_MALLOC_F_LEN=0x4000
CONFIG_NR_DRAM_BANKS=2
CONFIG_DM_GPIO=y
CONFIG_DEFAULT_DEVICE_TREE="an7581-evb-ramboot"
CONFIG_SYS_LOAD_ADDR=0x81800000
CONFIG_BUILD_TARGET="u-boot.bin"
# CONFIG_EFI_LOADER is not set
CONFIG_FIT=y
CONFIG_FIT_VERBOSE=y
CONFIG_DEFAULT_FDT_FILE="an7581-evb-ramboot.dtb"
CONFIG_LOGLEVEL=9
CONFIG_LOG=y
CONFIG_SYS_PBSIZE=1049
CONFIG_SYS_CONSOLE_IS_IN_ENV=y
CONFIG_DISPLAY_BOARDINFO=y
CONFIG_HUSH_PARSER=y
CONFIG_SYS_PROMPT="AN7581> "
CONFIG_SYS_MAXARGS=8
CONFIG_CMD_CPU=y
CONFIG_CMD_BOOTMENU=y
CONFIG_CMD_RNG=y
CONFIG_CMD_STRINGS=y
CONFIG_CMD_DM=y
CONFIG_CMD_GPIO=y
CONFIG_CMD_TFTPSRV=y
CONFIG_CMD_PING=y
CONFIG_CMD_CACHE=y
CONFIG_CMD_HASH=y
CONFIG_CMD_SMC=y
# CONFIG_ENV_IS_IN_MTD is not set
CONFIG_VERSION_VARIABLE=y
CONFIG_NETCONSOLE=y
CONFIG_USE_IPADDR=y
CONFIG_IPADDR="192.168.1.1"
CONFIG_USE_SERVERIP=y
CONFIG_SERVERIP="192.168.1.254"
CONFIG_NET_RANDOM_ETHADDR=y
CONFIG_BUTTON=y
CONFIG_BUTTON_GPIO=y
CONFIG_SYS_RELOC_GD_ENV_ADDR=y
CONFIG_SYS_RX_ETH_BUFFER=32
CONFIG_REGMAP=y
CONFIG_SYSCON=y
CONFIG_CLK=y
CONFIG_DMA=y
CONFIG_GPIO_HOG=y
CONFIG_AIROHA_ETH=y
CONFIG_DM_MDIO=y
CONFIG_CMD_MII=y
CONFIG_CMD_MDIO=y
CONFIG_PCS_AIROHA_AN7581=y
CONFIG_PHY=y
CONFIG_PINCTRL=y
CONFIG_PINCTRL_AIROHA_AN7581=y
CONFIG_POWER_DOMAIN=y
CONFIG_DM_REGULATOR=y
CONFIG_DM_REGULATOR_FIXED=y
CONFIG_RAM=y
CONFIG_DM_SERIAL=y
CONFIG_SYS_NS16550=y
CONFIG_SHA512=y
CONFIG_PCS_AIROHA_AN7581=y
CONFIG_AIROHA_BUILD_MODERN=y
```

## configs/an7589_evb_defconfig
```kconfig
CONFIG_ARM=y
CONFIG_POSITION_INDEPENDENT=y
CONFIG_ARCH_AIROHA=y
CONFIG_TARGET_AN7589=y
CONFIG_TEXT_BASE=0x81e00000
CONFIG_SYS_MALLOC_F_LEN=0x4000
CONFIG_NR_DRAM_BANKS=2
CONFIG_DM_GPIO=y
CONFIG_DEFAULT_DEVICE_TREE="an7589-evb"
CONFIG_SYS_LOAD_ADDR=0x81800000
CONFIG_BUILD_TARGET="u-boot.bin"
# CONFIG_BUILD_AIROHA is not set
CONFIG_LOGLEVEL=7
CONFIG_SYS_CONSOLE_IS_IN_ENV=y
CONFIG_LOG=y
CONFIG_HUSH_PARSER=y
CONFIG_SYS_PROMPT="AN7589> "
CONFIG_SYS_MAXARGS=8
CONFIG_SYS_PBSIZE=1049
CONFIG_BOOTDELAY=3
CONFIG_DEFAULT_FDT_FILE="an7589-evb.dtb"
CONFIG_CMD_BOOTMENU=y
CONFIG_CMD_ASKENV=y
CONFIG_CMD_ERASEENV=y
CONFIG_CMD_ENV_FLAGS=y
CONFIG_CMD_STRINGS=y
CONFIG_CMD_DM=y
CONFIG_CMD_GPIO=y
CONFIG_CMD_MTD=y
CONFIG_CMD_PART=y
CONFIG_CMD_CACHE=y
CONFIG_CMD_TIME=y
CONFIG_CMD_UUID=y
CONFIG_CMD_HASH=y
CONFIG_CMD_SMC=y
CONFIG_CMD_UBI=y
CONFIG_CMD_UBI_RENAME=y
CONFIG_CMD_PWM=y
CONFIG_ENV_OVERWRITE=y
# CONFIG_ENV_IS_IN_MTD is not set
CONFIG_ENV_IS_IN_UBI=y
CONFIG_ENV_REDUNDANT=y
CONFIG_ENV_UBI_PART="ubi"
CONFIG_ENV_UBI_VOLUME="ubootenv"
CONFIG_ENV_UBI_VOLUME_REDUND="ubootenv2"
CONFIG_ENV_UBI_VOLUME_CREATE=y
CONFIG_ENV_UBI_EXTRA_VOLUMES="0x40000(bosa),0x40000(ri),0x240000(art)"
CONFIG_ENV_RELOC_GD_ENV_ADDR=y
CONFIG_ENV_USE_DEFAULT_ENV_TEXT_FILE=y
CONFIG_ENV_DEFAULT_ENV_TEXT_FILE="defenvs/an7589_rfb_env"
CONFIG_ENV_VARS_UBOOT_RUNTIME_CONFIG=y
CONFIG_VERSION_VARIABLE=y
CONFIG_USE_IPADDR=y
CONFIG_IPADDR="192.168.1.1"
CONFIG_USE_SERVERIP=y
CONFIG_SERVERIP="192.168.1.254"
CONFIG_CLK=y
CONFIG_DM_RESET=y
CONFIG_DM_PWM=y
CONFIG_MTD=y
CONFIG_DM_MTD=y
CONFIG_MTD_SPI_NAND=y
CONFIG_MTD_UBI=y
CONFIG_UBI_BLOCK=y
CONFIG_PHY=y
CONFIG_PINCTRL=y
CONFIG_PINCTRL_AIROHA_AN7589=y
CONFIG_RAM=y
CONFIG_DM_RNG=y
CONFIG_RNG_AIROHA=y
CONFIG_DM_SERIAL=y
CONFIG_SYS_NS16550=y
CONFIG_SPI=y
CONFIG_DM_SPI=y
CONFIG_AIROHA_SNFI_SPI=y
CONFIG_TIMER=y
CONFIG_AIROHA_TIMER=y
# CONFIG_WATCHDOG_AUTOSTART is not set
CONFIG_WDT=y
CONFIG_WDT_AIROHA=y
# CONFIG_EFI_LOADER is not set
```

## drivers/mtd/nand/spi/Kconfig
```kconfig
menuconfig MTD_SPI_NAND
	bool "SPI NAND device Support"
	depends on DM_MTD && DM_SPI
	select DEVRES
	select MTD_NAND_CORE
	select SPI_MEM
	help
	  This is the framework for the SPI NAND device drivers.

config MTD_SPI_NAND_DEVICE_AUTOSELECT
	bool "Autoselect SPI Nand flash"
	default y
	help
	  By default, auto-selects frequent used SPI Nand flash.
	  Enable by default: ESMT, ETRON, FMSH, FORESEE, GIGADEVICE,
	  MACRONIX, MICRON, PARAGON, SKYHIGH, TOSHIBA, WINBOND, XTX.
	  Disable by default: ALLIANCEMEMORY, ATO.
	  If you want to add support for more SPI Nand flash chips,
	  please enable the corresponding option below.

config MTD_SPI_NAND_ALLIANCEMEMORY
	bool "ALLIANCEMEMORY SPI flash support"
	depends on MTD_SPI_NAND
	default n
	help
	  Add support for various ALLIANCEMEMORY SPI Nand flash chips

config MTD_SPI_NAND_ATO
	bool "ATO SPI flash support"
	depends on MTD_SPI_NAND
	default n
	help
	  Add support for various ATO SPI Nand flash chips

config MTD_SPI_NAND_ESMT
	bool "ESMT SPI flash support"
	depends on MTD_SPI_NAND
	default y if MTD_SPI_NAND_DEVICE_AUTOSELECT
	help
	  Add support for various ESMT SPI Nand flash chips

config MTD_SPI_NAND_ETRON
	bool "ETRON SPI flash support"
	depends on MTD_SPI_NAND
	default y if MTD_SPI_NAND_DEVICE_AUTOSELECT
	help
	  Add support for various ETRON SPI Nand flash chips

config MTD_SPI_NAND_FMSH
	bool "FMSH SPI flash support"
	depends on MTD_SPI_NAND
	default y if MTD_SPI_NAND_DEVICE_AUTOSELECT
	help
	  Add support for various FMSH SPI Nand flash chips

config MTD_SPI_NAND_FORESEE
	bool "FORESEE SPI flash support"
	depends on MTD_SPI_NAND
	default y if MTD_SPI_NAND_DEVICE_AUTOSELECT
	help
	  Add support for various FORESEE SPI Nand flash chips

config MTD_SPI_NAND_GIGADEVICE
	bool "GIGADEVICE SPI flash support"
	depends on MTD_SPI_NAND
	default y if MTD_SPI_NAND_DEVICE_AUTOSELECT
	help
	  Add support for various GIGADEVICE SPI Nand flash chips

config MTD_SPI_NAND_ICTHINK
	bool "IC-THINK SPI flash support"
	depends on MTD_SPI_NAND
	default n
	help
	  Add support for various IC-THINK SPI Nand flash chips

config MTD_SPI_NAND_ISSI
	bool "ISSI SPI flash support"
	depends on MTD_SPI_NAND
	default n
	help
	  Add support for various ISSI SPI Nand flash chips

config MTD_SPI_NAND_JSC
	bool "JSC SPI flash support"
	depends on MTD_SPI_NAND
	default n
	help
	  Add support for various JSC SPI Nand flash chips

config MTD_SPI_NAND_MACRONIX
	bool "MACRONIX SPI flash support"
	depends on MTD_SPI_NAND
	default y if MTD_SPI_NAND_DEVICE_AUTOSELECT
	help
	  Add support for various MACRONIX SPI Nand flash chips

config MTD_SPI_NAND_MICRON
	bool "MICRON SPI flash support"
	depends on MTD_SPI_NAND
	default y if MTD_SPI_NAND_DEVICE_AUTOSELECT
	help
	  Add support for various MICRON SPI Nand flash chips

config MTD_SPI_NAND_MIRA
	bool "MIRA SPI flash support"
	depends on MTD_SPI_NAND
	default n
	help
	  Add support for various MIRA SPI Nand flash chips

config MTD_SPI_NAND_PARAGON
	bool "PARAGON SPI flash support"
	depends on MTD_SPI_NAND
	default y if MTD_SPI_NAND_DEVICE_AUTOSELECT
	help
	  Add support for various PARAGON SPI Nand flash chips

config MTD_SPI_NAND_SILICONGO
	bool "SILICONGO SPI flash support"
	depends on MTD_SPI_NAND
	default n
	help
	  Add support for various SILICONGO SPI Nand flash chips

config MTD_SPI_NAND_SKYHIGH
	bool "SKYHIGH SPI flash support"
	depends on MTD_SPI_NAND
	default y if MTD_SPI_NAND_DEVICE_AUTOSELECT
	help
	  Add support for various SKYHIGH SPI Nand flash chips

config MTD_SPI_NAND_TOSHIBA
	bool "TOSHIBA SPI flash support"
	depends on MTD_SPI_NAND
	default y if MTD_SPI_NAND_DEVICE_AUTOSELECT
	help
	  Add support for various TOSHIBA SPI Nand flash chips

config MTD_SPI_NAND_WINBOND
	bool "WINBOND SPI flash support"
	depends on MTD_SPI_NAND
	default y if MTD_SPI_NAND_DEVICE_AUTOSELECT
	help
	  Add support for various WINBOND SPI Nand flash chips

config MTD_SPI_NAND_XTX
	bool "XTX SPI flash support"
	depends on MTD_SPI_NAND
	default y if MTD_SPI_NAND_DEVICE_AUTOSELECT
	help
	  Add support for various XTX SPI Nand flash chips
```
