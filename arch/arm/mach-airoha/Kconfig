## failsafe/Kconfig
```kconfig
#
# Failsafe Web UI
#

menuconfig WEBUI_FAILSAFE
	bool "Enable Failsafe Web UI"
	select MTK_TCP
	select MTK_HTTPD
	select MTK_DHCPD
	select MD5
	default n
	help
	  Enable the failsafe Web UI, a minimal Web server (httpd + dhcpd +
	  dnsd) that allows a device without a functional system image to be
	  recovered over the network: firmware / bootloader (the 512 KiB
	  u-boot image or the FIP) / preloader (bl2) / initramfs can be
	  uploaded and written to the corresponding storage.

	  The Web UI resources (fsdata) and the individual pages are selected
	  by the options below: each page is only embedded when the matching
	  option is enabled, and the UI dynamically shows the available
	  entries.

if WEBUI_FAILSAFE

config WEB_FAILSAFE_AFTER_BOOT_FAILURE
	bool "Automatically start failsafe after booting failure"
	default y
	help
	  This option allow user to upgrade a workable firmware image if no
	  firmware image available for boot.

	  It also enables the "bootfailsafe" command, which the boot scripts
	  run before their TFTP recovery fallback so that a failed boot has
	  priority over the (endless) TFTP recovery loop.

config WEBUI_FAILSAFE_LED
	bool "LED status indication"
	depends on LED
	default y
	help
	  Drive the board LEDs from the failsafe workflow: waiting for the
	  button, the idle web UI, an upgrade in progress and its result.

	  Labels and effects come from the environment only, so no board
	  code or device tree change is required:

	    failsafe_led_idle     waiting for a key press (btnchk)
	    failsafe_led_ready    web failsafe UI running and idle
	    failsafe_led_upgrade  an image is being flashed
	    failsafe_led_success  upgrade finished successfully
	    failsafe_led_fail     upgrade failed

	  An effect is a list of frames separated by ';', each frame is a
	  comma-separated list of '<led-label> [on|off|toggle|blink] [ms]'.
	  Frames rotate every 'failsafe_led_period' milliseconds (default
	  250) and LEDs that are not listed in the current frame are
	  switched off, so 'a on;b on;c on' rotates over three LEDs.  An
	  unset variable means no LED activity for that phase, and labels
	  that do not exist on the board are ignored - one environment
	  works on several boards.

	  This option is automatically unavailable on boards without LED
	  support (it depends on CONFIG_LED); when disabled, the LED
	  handling is compiled out completely and every caller turns into
	  an empty stub.

choice
	prompt "Failsafe layout"
	default WEBUI_FAILSAFE_LAYOUT_UBOOT
	help
	  Select the bootloader layout the failsafe covers, which also
	  decides its feature set and the embedded web resources (fsdata).

config WEBUI_FAILSAFE_LAYOUT_UBOOT
	bool "U-Boot layout (u-boot MTD partition)"
	help
	  512 KiB boot image layout:
	    - System firmware upgrade  (UBI FIT volume "fit")
	    - U-Boot upgrade           (u-boot MTD partition)
	    - Initramfs RAM boot

config WEBUI_FAILSAFE_LAYOUT_FIP
	bool "FIP layout (bl2 + fip partitions)"
	help
	  Split FIP layout:
	    - System firmware upgrade  (UBI FIT volume "fit")
	    - Preloader upgrade        (bl2 MTD partition)
	    - FIP upgrade              (UBI volume "fip")
	    - Initramfs RAM boot

config WEBUI_FAILSAFE_LAYOUT_CHAINLOADER
	bool "Chainloader layout (bl2 + chainloader partitions)"
	help
	  Chainloader failsafe:
	    - System firmware upgrade  (UBI FIT volume "fit")
	    - Preloader upgrade        (bl2 MTD partition)
	    - Chainloader upgrade      (chainloader MTD partition)
	    - Initramfs RAM boot

endchoice

choice
	prompt "Failsafe Web UI style"
	default WEBUI_FAILSAFE_UI_BOOTSTRAP
	help
	  Select which Web UI resources to embed into the failsafe firmware
	  image.

config WEBUI_FAILSAFE_UI_BOOTSTRAP
	bool "Bootstrap UI (fsdata-bootstrap)"

config WEBUI_FAILSAFE_UI_BRUTALISM
	bool "Brutalism UI (fsdata-brutalism)"
	depends on WEBUI_FAILSAFE_LAYOUT_UBOOT

endchoice

config WEBUI_FAILSAFE_BUILD_VARIANT
	string "Failsafe build variant tag"
	default ""
	help
	  Optional build variant string shown in the failsafe sysinfo page,
	  e.g. "wifi7" or a customer specific tag.

config WEBUI_FAILSAFE_I18N
	bool "Enable I18N dictionary for Web UI"
	default y
	help
	  Embed the i18n.js dictionary so the Web UI can be localized.

if WEBUI_FAILSAFE_I18N

comment "Embedded languages"

config WEBUI_FAILSAFE_I18N_EN
	bool "English"
	default y
	help
	  English is the fallback language of the Web UI and should stay
	  enabled.  Disabling it only removes it from the language
	  switcher; the UI then falls back to another embedded language.

config WEBUI_FAILSAFE_I18N_ZH_CN
	bool "Simplified Chinese"
	default n
	help
	  Embed the zh-cn dictionary (about 5 KiB of compressed data).

config WEBUI_FAILSAFE_I18N_RU
	bool "Russian"
	default n
	help
	  Embed the ru dictionary (about 5 KiB of compressed data).

endif # WEBUI_FAILSAFE_I18N

choice
	prompt "Embedded Web UI asset compression"
	default WEBUI_FAILSAFE_COMPRESS_GZIP
	help
	  How the embedded HTML / CSS / JS / SVG assets are stored and
	  served.

	  NOTE: the failsafe httpd does NOT implement Accept-Encoding
	  negotiation - it always advertises the encoding selected here.
	  Brotli was tried but had to be dropped: browsers never advertise
	  "br" over the plain-HTTP connection the failsafe UI is served on,
	  so brotli payloads always failed to decode on the client.

config WEBUI_FAILSAFE_COMPRESS_GZIP
	bool "gzip -9 (default, universally supported)"
	help
	  Historical behaviour: assets are gzip -9 compressed and served
	  with "Content-Encoding: gzip".  Every HTTP client understands
	  this.

config WEBUI_FAILSAFE_COMPRESS_NONE
	bool "None - store the minified assets as-is"
	help
	  Store the minified (but not compressed) assets and serve them
	  with no Content-Encoding at all, so no client-side decoding is
	  involved.

	  This is usually the SMALLEST option in the final image: the
	  finished u-boot.bin is LZMA compressed as a whole and LZMA
	  squeezes plain text far better than it can squeeze an already
	  compressed gzip stream (about 49 KiB vs 64 KiB for the
	  current asset set, i.e. roughly 15 KiB saved versus gzip).

	  The trade-off is runtime RAM: the assets occupy about 155 KiB
	  more of the decompressed U-Boot image, and a full page load
	  transfers about 200 KiB instead of 65 KiB (irrelevant on a
	  LAN).

endchoice

config WEBUI_FAILSAFE_ADVANCED
	bool "Enable advanced features"
	default n
	help
	  Advanced failsafe features: Web console, U-Boot environment
	  management, UBI volume management, RF-EEPROM / single-image
	  upgrade pages.

if WEBUI_FAILSAFE_ADVANCED

config WEBUI_FAILSAFE_CONSOLE
	bool "Enable Web console"
	select CONSOLE_RECORD
	default y
	help
	  Enable the Web console page. Requires a UART console driver.

config WEBUI_FAILSAFE_ENV
	bool "Enable U-Boot environment management"
	default y
	help
	  Enable the U-Boot environment page: read / write / reset
	  environment variables from the Web UI.

config WEBUI_FAILSAFE_UBI
	bool "Enable UBI volume management"
	default y
	depends on MTD && !ENV_IS_IN_MMC
	select CMD_UBI
	help
	  Enable the UBI volume management page: list / attach / detach /
	  remove / resize UBI volumes. Useful on SPI-NAND / SPI-NOR boards
	  where the system image lives in a UBI volume.

config WEBUI_FAILSAFE_SIMG
	bool "Enable SIMG (ROM dump) restore"
	default n
	depends on MTD
	help
	  Enable the SIMG page: upload a single raw image (a full ROM dump
	  of the flash chip) and write it to the whole flash device.

	  The image is streamed to the device in erase-block aligned
	  chunks, so a full dump can be restored without staging it in
	  RAM.  There is no read / erase / offset editing: the only
	  operation is "upload a SIMG and write it".

	  WARNING: writing a wrong image overwrites the whole flash,
	  including bootloaders and calibration data.

endif # WEBUI_FAILSAFE_ADVANCED

endif # WEBUI_FAILSAFE
```
