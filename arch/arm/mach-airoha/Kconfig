## arch/arm/mach-airoha/Kconfig
```kconfig
if ARCH_AIROHA

config SYS_VENDOR
	default "airoha"

choice
	prompt "Airoha board select"

config TARGET_EN7523
	bool "Airoha EN7523 SoC"
	select CPU_V7A
	select ARMV7_SET_CORTEX_SMPEN
	select REGMAP
	help
	  The Airoha EN7523 family (en7523/en7529/en7562) is an ARM-based
	  SoCs with a dual-core CPU. It comes with Wi-Fi 5/6 support and
	  connectivity to Ethernet PHY, DDR, PCIe, USB, UART and VoIP.
	  With advanced hardware design, EN7523 provides high processing
	  performance and low power consumption.

config TARGET_AN7581
	bool "Airoha AN7581 SoC"
	select ARM64
	help
	  The Airoha EN7581 is a ARM-based SoC with a quad-core Cortex-A7
	  including NEON and GPU, Mali-450 graphics, several DDR3 options,
	  crypto engine, built-in Wi-Fi / Bluetooth combo chip, JPEG decoder,
	  video interfaces supporting HDMI and MIPI, and video codec support.
	  Peripherals include Gigabit Ethernet, switch, USB3.0 and OTG, PCIe,
	  I2S, PCM, S/PDIF, UART, SPI, I2C, IR TX/RX, and PWM.

config TARGET_AN7583
	bool "Airoha AN7583 SoC"
	select ARM64
	help
	  The Airoha AN7583 is a ARM-based SoC with a quad-core Cortex-A7
	  including NEON and GPU, Mali-450 graphics, several DDR3 options,
	  crypto engine, built-in Wi-Fi / Bluetooth combo chip, JPEG decoder,
	  video interfaces supporting HDMI and MIPI, and video codec support.
	  Peripherals include Gigabit Ethernet, switch, USB3.0 and OTG, PCIe,
	  I2S, PCM, S/PDIF, UART, SPI, I2C, IR TX/RX, and PWM.

config TARGET_AN7563
	bool "Airoha AN7563 SoC"
	select CPU_V7A
	select ARMV7_SET_CORTEX_SMPEN
	help
	  The Airoha AN7563 (a.k.a. AN7552) is an Airoha SoC built around a
	  dual Cortex-A53 cluster running ARMv8 in 32-bit AArch32 mode. It
	  shares the EN7581 chip-SCU / SCU register layout (in particular
	  the IOMUX_1 register at chip-SCU offset 0x214), so the SCU nodes
	  carry an "airoha,en7581-{chip-,}scu" fallback compatible to share
	  the EN7581 clock and reset descriptor tables. The CPU side keeps
	  the EN7523 ARMv7-A code path because AN7563 boots in AArch32
	  mode.

endchoice

config SYS_SOC
	default "en7523" if TARGET_EN7523
	default "an7581" if TARGET_AN7581
	default "an7583" if TARGET_AN7583
	default "an7563" if TARGET_AN7563

config SYS_BOARD
	default "en7523" if TARGET_EN7523
	default "an7581" if TARGET_AN7581
	default "an7583" if TARGET_AN7583
	default "an7563" if TARGET_AN7563

config SYS_CONFIG_NAME
	default "en7523" if TARGET_EN7523
	default "an7581" if TARGET_AN7581
	default "an7583" if TARGET_AN7583
	default "an7563" if TARGET_AN7563

endif
```
