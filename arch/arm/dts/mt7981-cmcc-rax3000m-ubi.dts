// SPDX-License-Identifier: GPL-2.0-only

#include "mt7981-cmcc-rax3000m.dtsi"

/ {
	model = "CMCC RAX3000M (UBI)";
	compatible = "cmcc,rax300m-ubi", "mediatek,mt7981", "mediatek,mt7981-rfb";
};

&partitions {
	partition@100000 {
		label = "ubi";
		reg = <0x100000 0x0>;
	};
};
