// SPDX-License-Identifier: (GPL-2.0-only OR BSD-2-Clause)
/dts-v1/;

#include "en7523-evb.dts"

/ {
	model = "Airoha EN7562 Evaluation Board";
	compatible = "airoha,en7562-evb", "airoha,en7523-evb",
		     "airoha,en7562", "airoha,en7523";
};
