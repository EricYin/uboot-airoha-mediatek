/dts-v1/;

/ {
    compatible = "airoha,xr1710g-chainloader-control";
    fit-base = <0x81800000>;
    payload-node = "uboot@1";
    fallback-payload-load = <0x81e00000>;
    fallback-payload-entry = <0x81e00000>;
};
